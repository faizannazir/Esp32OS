## sdkconfig.defaults
```kconfig
# ESP32OS SDK Configuration Defaults
# These are applied when running `idf.py set-target esp32`

# Partition table
CONFIG_PARTITION_TABLE_CUSTOM=y
CONFIG_PARTITION_TABLE_CUSTOM_FILENAME="partitions.csv"
CONFIG_PARTITION_TABLE_OFFSET=0x8000

# SPIFFS
CONFIG_SPIFFS_USE_MAGIC=y
CONFIG_SPIFFS_META_LENGTH=4

# FreeRTOS
CONFIG_FREERTOS_HZ=1000
CONFIG_FREERTOS_USE_TRACE_FACILITY=y
CONFIG_FREERTOS_GENERATE_RUN_TIME_STATS=y
CONFIG_FREERTOS_USE_STATS_FORMATTING_FUNCTIONS=y
CONFIG_FREERTOS_VTASKLIST_INCLUDE_COREID=y

# Stack sizes
CONFIG_ESP_MAIN_TASK_STACK_SIZE=8192
CONFIG_ESP_SYSTEM_EVENT_TASK_STACK_SIZE=4096

# UART
CONFIG_ESP_CONSOLE_UART_NUM=0
CONFIG_ESP_CONSOLE_UART_BAUDRATE=115200

# Flash size
CONFIG_ESPTOOLPY_FLASHSIZE_4MB=y

# WiFi
CONFIG_ESP_WIFI_STATIC_RX_BUFFER_NUM=10
CONFIG_ESP_WIFI_DYNAMIC_RX_BUFFER_NUM=32
CONFIG_ESP_WIFI_TX_BUFFER_TYPE=1
CONFIG_ESP_WIFI_AMPDU_TX_ENABLED=y
CONFIG_ESP_WIFI_AMPDU_RX_ENABLED=y

# lwIP
CONFIG_LWIP_TCPIP_TASK_STACK_SIZE=4096
CONFIG_LWIP_SO_RCVBUF=y

# Heap
CONFIG_HEAP_TRACING_STANDALONE=n
CONFIG_HEAP_POISONING_DISABLED=y

# Watchdog
CONFIG_ESP_TASK_WDT_INIT=y
CONFIG_ESP_TASK_WDT_TIMEOUT_S=30
CONFIG_ESP_TASK_WDT_CHECK_IDLE_TASK_CPU0=y

# Logging
CONFIG_LOG_DEFAULT_LEVEL_INFO=y
CONFIG_LOG_MAXIMUM_LEVEL_VERBOSE=y

# Core dump
CONFIG_ESP_COREDUMP_ENABLE_TO_FLASH=y

# Flash encryption (disabled for dev)
CONFIG_SECURE_FLASH_ENC_ENABLED=n

# Drivers
CONFIG_I2C_SUPPRESS_DEPRECATE_WARN=y

# OTA
```
